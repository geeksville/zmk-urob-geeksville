#define CONFIG_WIRELESS

// 6th layer
#define GAME 6 

#define ZMK_42_LAYER(name, LT, RT, LM, RM, LB, RB, LH, RH, OLT, OLM, OLB, ORT, ORM, ORB, OLH, ORH)     \
    ZMK_LAYER(                                                   \
        name,                                                    \
        &none &none &none &none &none &none   &mkp LCLK &mkp RCLK &mkp MCLK &none &none &none \
        OLT LT                                RT ORT               \
        OLM LM                                RM ORM               \
        OLB LB                                RB ORB               \
        OLH LH RH ORH  )

#define ZMK_BASE_LAYER(name, LT, RT, LM, RM, LB, RB, LH, RH)     \
    ZMK_42_LAYER(name, LT, RT, LM, RM, LB, RB, LH, RH, \
        ___, ___, ___,                          \
        ___, ___, &to GAME,                     \
        &kp LGUI, &none                         \
    )

#include "zmk_42_layer.h"
#include "crosses.h"
#include "base.keymap"
#include "game_layer.h"
#include "zmk_studio.h"
