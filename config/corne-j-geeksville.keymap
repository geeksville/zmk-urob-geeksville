#define CONFIG_WIRELESS
#define ZMK_BASE_LAYER(name, LT, RT, LM, RM, LB, RB, LH, RH)     \
    ZMK_LAYER(                                                   \
        name,                                                    \
        &none LT                 &none        RT &none           \
        &none LM           &none &none &none  RM &none           \
        &none LB &none           &none        RB &none           \  
                                                                 \      
        &none LH RH &none  )


#include "zmk-helpers/key-labels/eyelash42.h"
#include "base.keymap"
